#include "wake_log.h"
#include "firmware_version.h" // generated by tools/version.py
#include "sdcard.h"
#include "hardware/watchdog.h"
#include "pico/time.h"

#include <stdio.h>
#include <string.h>

#define LOG_FILE SDCARD_FRAME_DIR "/log.csv"
#define OLD_FILE SDCARD_FRAME_DIR "/log.old.csv"
#ifndef WAKE_LOG_MAX_BYTES
#define WAKE_LOG_MAX_BYTES (256 * 1024) // log.csv is rotated before it grows past this
#endif

static const char *const step_names[STEP_COUNT] = {"idle", "boot", "card", "select", "load", "refresh", "save", "drive"};

WakeLog wake_log;
static WakeStep current_step;
static uint32_t step_start_ms;

void wake_log_step(WakeStep step)
{
    uint32_t now = to_ms_since_boot(get_absolute_time());
    if (current_step != STEP_IDLE)
        wake_log.ms[current_step] += now - step_start_ms;
    current_step = step;
    step_start_ms = now;
    watchdog_hw->scratch[0] = step;
}

const char *wake_log_boot_reason(const char *otherwise)
{
    static char reason[24];
    uint32_t step = watchdog_hw->scratch[0];
    if (!watchdog_enable_caused_reboot()) // a timeout, not a reboot asked for (e.g. into BOOTSEL)
        return otherwise;
    snprintf(reason, sizeof(reason), "watchdog:%s", step < STEP_COUNT ? step_names[step] : "?");
    return reason;
}

// A CSV field: quoted, with quotes doubled, if it holds a comma, quote or line break
static bool put_field(char **p, char *end, const char *s)
{
    bool quote = strpbrk(s, ",\"\r\n") != NULL;
    if (quote && *p < end)
        *(*p)++ = '"';
    for (; *s; s++)
    {
        if (*s == '"' && *p < end)
            *(*p)++ = '"';
        if (*p < end)
            *(*p)++ = *s;
    }
    if (quote && *p < end)
        *(*p)++ = '"';
    return *p < end;
}

bool wake_log_format(char *out, size_t len, const char *event, const WakeLog *w)
{
    // The load column holds the session length on drive_end lines
    uint32_t load = strcmp(event, "drive_end") == 0 ? w->ms[STEP_DRIVE] : w->ms[STEP_LOAD];
    int n = snprintf(out, len, "%s,%s,%s,%.2f,%d,%d,%d,%lu,%lu,%lu,%lu,%lu,", event, w->reason ? w->reason : "",
                     FIRMWARE_VERSION, (double)w->battery_v, w->usb, w->charging, w->interval_h,
                     (unsigned long)w->ms[STEP_BOOT],
                     (unsigned long)w->ms[STEP_CARD], (unsigned long)w->ms[STEP_SELECT], (unsigned long)load,
                     (unsigned long)w->ms[STEP_REFRESH]);
    if (n < 0 || (size_t)n >= len)
        return false;
    char *p = out + n, *end = out + len - 1;
    if (!put_field(&p, end, w->photo))
        return false;
    n = snprintf(p, (size_t)(end - p) + 1, ",%s,%d,%d", w->result ? w->result : "", w->photos, w->failed);
    return n >= 0 && n <= end - p;
}

// Move a full log.csv to log.old.csv (replacing it), so the next line starts a new file
static void rotate_if_full(void)
{
    FILINFO fno;
    if (f_stat(LOG_FILE, &fno) != FR_OK || fno.fsize < WAKE_LOG_MAX_BYTES)
        return;
    f_unlink(OLD_FILE); // f_rename does not replace
    f_rename(LOG_FILE, OLD_FILE);
}

void wake_log_write(const char *event)
{
    if (current_step != STEP_IDLE)
        wake_log_step(STEP_IDLE);
    char line[FF_LFN_BUF + 160];
    if (wake_log_format(line, sizeof(line), event, &wake_log))
    {
        sdcard_mount();
        sdcard_make_frame_dir();
        rotate_if_full();
        FIL fil;
        if (f_open(&fil, LOG_FILE, FA_OPEN_APPEND | FA_WRITE) == FR_OK)
        {
            if (f_size(&fil) == 0)
                f_puts(WAKE_LOG_HEADER "\n", &fil);
            f_puts(line, &fil);
            f_puts("\n", &fil);
            f_close(&fil);
        }
        sdcard_unmount();
    }
    // Per change; the reason and battery stay for the rest of the wake
    memset(wake_log.ms, 0, sizeof(wake_log.ms));
    wake_log.photo[0] = '\0';
    wake_log.result = NULL;
    wake_log.photos = wake_log.failed = 0;
}
