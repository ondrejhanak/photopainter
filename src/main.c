#include "display.h"
#include "EPD_7in3f.h" // EPD_7IN3F_BusyWait()
#include "cache.h"
#include "images.h"
#include "messages.h"
#include "sdcard.h"
#include "led.h"
#include "waveshare_PCF85063.h" // RTC
#include "DEV_Config.h"
#include "settings.h"
#include "usb_serial.h"
#include "usb_drive.h"
#include "firmware_version.h" // generated by tools/version.py
#include <time.h>

// State shared by setup() and loop()
// Arbitrary reference time (2000-01-01 00:00:00): the RTC is reset to it on every run and the
// alarm is set relative to it, so only the interval matters; the date is never read or shown
static Time_data reference_time = {0, 1, 1, 0, 0, 0};
static bool card_present = false;
static bool charging_mode = false; // powered over USB at boot; loop() only acts in this mode

// KEY on USB: short press (released before LONG_PRESS_MS) = next image, long press = drive mode on/off
#define LONG_PRESS_MS 3000
#define LOOP_MS 50 // KEY check interval on USB; shorter taps can be missed

// Drive mode ends by itself when the computer did not read the drive (mount failed, or it gave up)
// or left it idle for long (forgotten eject, computer asleep), so the photos don't stop for good
#define DRIVE_UNUSED_MS (60 * 1000UL)
#define DRIVE_IDLE_MS (30 * 60 * 1000UL)
static bool key_down = false;
static uint32_t key_down_ms; // when KEY went down
static bool long_press_done = false; // long press already handled, wait for release

// Drive mode: the computer owns the SD card, the frame must not touch it (no card reads, no state.txt)
static bool drive_mode = false;
static uint32_t drive_mode_ms; // when drive mode started

// Red LED: steady on in drive mode, otherwise lit while the SD card is in use, so it shows the frame
// is busy. A long press also lights it when reached, until whatever it does next sets it
static void set_led(bool card_active)
{
    DEV_Digital_Write(LED_ACT, card_active || drive_mode);
}

// Called by the SD driver on every card access
void sd_activity(bool active)
{
    set_led(active);
}

// Battery levels, provisional until tuned from a logged discharge curve. Measured once per wake at
// boot, before the card and the panel draw current
#define BATTERY_LOW_V 3.5f // battery icon on the photo
#define BATTERY_EMPTY_V 3.3f // "Battery Empty" screen, then no changes until charged
#define BATTERY_FLOOR_V 3.1f // no refresh at all: a brown-out mid-refresh leaves the panel black
static float battery_voltage;

static float measure_battery_voltage(void)
{
    uint32_t sum = 0;
    for (int i = 0; i < 8; i++)
        sum += adc_read();
    float voltage = sum / 8.0f * 3.3f / (1 << 12) * 3; // the board divides VBAT by 3
    printf("battery: %.2f V\r\n", voltage);
    return voltage;
}

static void show_charge_state(void)
{
    if (DEV_Digital_Read(VBUS))
    {
        if (!DEV_Digital_Read(CHARGE_STATE))
        { // is charging
            ledCharging();
        }
        else
        { // charge complete
            ledCharged();
        }
    }
}

static void charge_state_callback(uint gpio, uint32_t events)
{
    (void)gpio;
    (void)events;
    show_charge_state();
}

// Reset the RTC to the reference time and set the alarm interval_hours (settings.ini) later
static void arm_alarm(void)
{
    Time_data alarm_time = reference_time;
    alarm_time.hours += settings.interval_hours;
    rtcRunAlarm(reference_time, alarm_time);
}

static void show_next(void)
{
    if (!card_present)
        display_message(msg(MSG_NO_CARD_TITLE), msg(MSG_NO_CARD_HINT));
    else if (!images_select_next())
        display_message(msg(MSG_NO_IMAGES_TITLE), msg(MSG_NO_IMAGES_HINT));
    else
        display_image(!DEV_Digital_Read(VBUS) && battery_voltage < BATTERY_LOW_V); // charging on USB

    PCF85063_clear_alarm_flag();
    arm_alarm();
}

// Detect the SD card and read settings.ini, so a card inserted or changed while on USB is picked up
static void scan_card(void)
{
    card_present = sdcard_present();
    if (card_present)
        settings_load();
}

// On USB: re-scan the card and show the next image
static void next_image(const char *reason)
{
    printf("%s: next image\r\n", reason);
    scan_card();
    show_next();
    usb_serial_discard(); // commands sent during the refresh would queue more refreshes
}

// Insert the card into the USB drive, then show the drive-mode screen; the computer is served during
// the refresh (EPD_7IN3F_BusyWait())
static void enter_drive_mode(const char *reason)
{
    printf("%s: drive mode\r\n", reason);
    if (!usb_drive_computer_connected())
    { // plain charger: no drive mode, the photo stays; the red LED blinks 3 times instead
        printf("no computer connected\r\n");
        for (int i = 0; i < 3; i++)
        {
            DEV_Digital_Write(LED_ACT, 0);
            DEV_Delay_ms(150);
            DEV_Digital_Write(LED_ACT, 1);
            DEV_Delay_ms(150);
        }
        set_led(false);
        return;
    }
    scan_card(); // card check and language for the screen
    if (card_present)
        images_remember_photos();
    if (!card_present)
        show_next(); // "no card" screen
    else if (!usb_drive_start())
        show_next();
    else
    {
        drive_mode = true;
        drive_mode_ms = to_ms_since_boot(get_absolute_time());
        set_led(false);
        display_message(msg(MSG_DRIVE_TITLE), msg(MSG_DRIVE_HINT));
    }
    usb_serial_discard(); // commands sent during the refresh
}

// Take the card back, then re-read it and settings.ini (the computer may have changed both), show
// the first photo it added (or the next image) and remove cache files of photos it deleted or replaced
static void leave_drive_mode(const char *reason)
{
    usb_drive_stop();
    drive_mode = false;
    set_led(false);
    printf("%s: leaving drive mode\r\n", reason);
    scan_card();
    if (card_present)
        images_find_new();
    show_next();
    usb_serial_discard(); // commands sent during the refresh
    if (card_present)
    {
        sdcard_mount();
        cache_prune();
        sdcard_unmount();
    }
}

// Runs while the panel refreshes: in drive mode the computer keeps being served
void EPD_7IN3F_BusyWait(UDOUBLE ms)
{
    if (drive_mode)
        usb_drive_serve(ms);
    else
        DEV_Delay_ms(ms);
}

// Arduino-Pico entry points: the core's main() starts USB serial, then calls setup() and loop()
void setup(void)
{
    printf("PhotoPainter %s\r\n", FIRMWARE_VERSION);
    printf("Init...\r\n");
    if (DEV_Module_Init() != 0)
    {
        return;
    }

    watchdog_enable(8 * 1000, 1);
    DEV_Delay_ms(1000);
    PCF85063_init();
    arm_alarm(); // default interval until settings.ini is read, in case anything below fails
    gpio_set_irq_enabled_with_callback(CHARGE_STATE, GPIO_IRQ_EDGE_RISE | GPIO_IRQ_EDGE_FALL, true, charge_state_callback);

    battery_voltage = measure_battery_voltage();
    if (battery_voltage < BATTERY_FLOOR_V)
    { // battery power is low
        printf("low power ...\r\n");
        PCF85063_alarm_Time_Disable();
        ledLowPower();
        powerOff();
        return;
    }
    else
    {
        printf("work ...\r\n");
        ledPowerOn();
    }

    settings_init(); // language for screens shown without a readable card
    scan_card();
    arm_alarm(); // re-arm with interval_hours from settings.ini

    if (!DEV_Digital_Read(VBUS))
    { // on battery: show the next image and cut power until the RTC alarm wakes us up
        if (battery_voltage < BATTERY_EMPTY_V)
        { // no more wake-ups: KEY or USB power starts the frame again
            display_message(msg(MSG_BATTERY_EMPTY_TITLE), msg(MSG_BATTERY_EMPTY_HINT));
            PCF85063_alarm_Time_Disable();
        }
        else
            show_next();
        printf("power off ...\r\n");
        powerOff();
        return;
    }

    // on USB power: stay awake, loop() handles KEY presses until USB is unplugged
    show_charge_state();
    charging_mode = true;
}

void loop(void)
{
    if (!charging_mode)
        return;

    if (!DEV_Digital_Read(VBUS))
    { // USB unplugged
        printf("power off ...\r\n");
        powerOff();
        charging_mode = false;
        return;
    }

    // KEY and the RTC alarm both pull BAT_STATE low on this board (both feed the power-on circuit
    // that wakes the device on battery). The alarm holds the line until its flag is cleared, so
    // the flag tells it apart from a long KEY press
    bool line_low = !DEV_Digital_Read(BAT_STATE);
    uint32_t now_ms = to_ms_since_boot(get_absolute_time());
    // The flag is checked while KEY is held too: an alarm during a press keeps the line low after
    // the release, which would otherwise look like KEY held forever
    if (line_low && PCF85063_get_alarm_flag())
    {
        key_down = false;
        long_press_done = false;
        set_led(false);
        if (drive_mode)
        { // only re-arm, the next image is due after leaving drive mode
            printf("rtc alarm in drive mode\r\n");
            PCF85063_clear_alarm_flag();
            arm_alarm();
        }
        else
            next_image("rtc alarm");
    }
    else if (line_low && !key_down)
    {
        key_down = true;
        key_down_ms = now_ms;
        printf("key down\r\n");
    }
    else if (line_low && !long_press_done && now_ms - key_down_ms >= LONG_PRESS_MS)
    {
        long_press_done = true;
        DEV_Digital_Write(LED_ACT, 1); // the user can let go
        printf("long key press\r\n");
        if (drive_mode)
            leave_drive_mode("long key press");
        else
            enter_drive_mode("long key press");
    }
    else if (!line_low && key_down)
    {
        printf("key up after %lu ms\r\n", (unsigned long)(now_ms - key_down_ms));
        key_down = false;
        set_led(false);
        if (!long_press_done && !drive_mode)
            next_image("short key press");
        long_press_done = false;
    }

    // Test commands over USB serial, so log-only device tests need no KEY press. Read in drive mode
    // too, so nothing sent meanwhile runs after it
    int command = usb_serial_read();
    if (drive_mode)
    { // commands are ignored, eject, a long press or a timeout leaves drive mode
        usb_drive_serve(LOOP_MS); // answers the computer instead of the delay below
        if (usb_drive_ejected())
            leave_drive_mode("ejected");
        else if (!usb_drive_used() && to_ms_since_boot(get_absolute_time()) - drive_mode_ms > DRIVE_UNUSED_MS)
            leave_drive_mode("drive not used by the computer");
        else if (usb_drive_idle_ms() > DRIVE_IDLE_MS)
            leave_drive_mode("drive idle");
        return;
    }
    if (command == 'n')
        next_image("serial command");
    else if (command == 'd')
        enter_drive_mode("serial command");

    DEV_Delay_ms(LOOP_MS);
}
